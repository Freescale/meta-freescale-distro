## conf/distro/fsl-x11.conf
```bitbake
# FSL Distro for X11 without wayland.

require conf/distro/include/fsl-base.inc

DISTRO = "fsl-x11"
DISTRO_NAME = "FSL X11"

# Remove conflicting backends.
DISTRO_FEATURES_remove = "wayland "

# These are X11 specific
DISTRO_FEATURES_append = " x11"
```

## conf/distro/include/fslc-base.inc
```bitbake
require conf/distro/poky.conf

DISTRO = "fslc-base"
DISTRO_NAME = "FSLC Distro Base"
DISTRO_VERSION = "5.0"

SDK_VENDOR = "-fslcsdk"

MAINTAINER = "FSL Community Team <meta-freescale@yoctoproject.org>"

TARGET_VENDOR = "-fslc"

DISTROOVERRIDES = "fslc"

# This function changes the default tune for machines which are based on armv7a
# to use common tune value
def arm_tune_handler(d):
    features = d.getVar('TUNE_FEATURES', True).split()
    if 'armv7a' in features or 'armv7ve' in features:
        tune = 'armv7athf'
        if 'bigendian' in features:
            tune += 'b'
        if 'vfpv3' in features:
            tune += '-vfpv3'
        if 'vfpv3d16' in features:
            tune += '-vfpv3d16'
        if 'neon' in features:
            tune += '-neon'
        if 'vfpv4' in features:
            tune += '-vfpv4'
    else:
        tune = d.getVar('DEFAULTTUNE', True)
    return tune

DEFAULTTUNE:fslc := "${@arm_tune_handler(d)}"

PACKAGECONFIG:remove:pn-xserver-xorg:armv5 = "dri"

# Log information on images and packages
INHERIT += "buildhistory"
BUILDHISTORY_COMMIT ?= "1"
```

## conf/layer.conf
```bitbake
# We have a conf and classes directory, add to BBPATH
BBPATH .= ":${LAYERDIR}"

# We have a packages directory, add to BBFILES
BBFILES += "${LAYERDIR}/recipes-*/*/*.bb \
            ${LAYERDIR}/recipes-*/*/*.bbappend"

BBFILE_COLLECTIONS += "freescale-distro"
BBFILE_PATTERN_freescale-distro := "^${LAYERDIR}/"
BBFILE_PRIORITY_freescale-distro = "4"
# This is a distro-configuration-only layer and ships no recipes, so tell
# BitBake not to warn when BBFILE_PATTERN matches no bb files.
BBFILE_PATTERN_IGNORE_EMPTY_freescale-distro = "1"

LAYERDEPENDS_freescale-distro = "core yocto"

LAYERSERIES_COMPAT_freescale-distro = "whinlatter wrynose"
```

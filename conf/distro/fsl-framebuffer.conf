## conf/distro/fsl-framebuffer.conf
```bitbake
# FSL Distro for FrameBuffer graphical backend.

require conf/distro/poky.conf

SDK_VENDOR = "-fslsdk"

MAINTAINER = "Freescale Semiconductors <lauren.post@nxp.com>"

TARGET_VENDOR = "-fsl"

DISTROOVERRIDES = "fsl"

require conf/distro/include/fsl-distro-common.inc

DISTRO = "fsl-framebuffer"
DISTRO_NAME = "FSL FrameBuffer"

require conf/fragments/bsp/nxp.conf
require conf/fragments/graphics/framebuffer.conf
```

## conf/distro/fsl-wayland.conf
```bitbake
# FSL Distro for Wayland.

require conf/distro/poky.conf

SDK_VENDOR = "-fslsdk"

MAINTAINER = "Freescale Semiconductors <lauren.post@nxp.com>"

TARGET_VENDOR = "-fsl"

DISTROOVERRIDES = "fsl"

require conf/distro/include/fsl-distro-common.inc

DISTRO = "fsl-wayland"
DISTRO_NAME = "FSL Wayland"

# Define Init System
INIT_MANAGER = "systemd"

require conf/fragments/bsp/nxp.conf
require conf/fragments/graphics/wayland.conf
```

## conf/distro/fsl-xwayland.conf
```bitbake
# FSL Distro for Wayland with XWayland.

require conf/distro/poky.conf

SDK_VENDOR = "-fslsdk"

MAINTAINER = "Freescale Semiconductors <lauren.post@nxp.com>"

TARGET_VENDOR = "-fsl"

DISTROOVERRIDES = "fsl"

require conf/distro/include/fsl-distro-common.inc

DISTRO = "fsl-xwayland"
DISTRO_NAME = "FSL Wayland with XWayland"

# Define Init System
INIT_MANAGER = "systemd"

require conf/fragments/bsp/nxp.conf
require conf/fragments/graphics/xwayland.conf
```

## conf/distro/fslc-framebuffer.conf
```bitbake
# FSLC Distro for FrameBuffer graphical backend.

require conf/distro/poky.conf

SDK_VENDOR = "-fslcsdk"

MAINTAINER = "FSL Community Team <meta-freescale@yoctoproject.org>"

TARGET_VENDOR = "-fslc"

DISTROOVERRIDES = "fslc"

require conf/distro/include/fsl-distro-common.inc

DISTRO = "fslc-framebuffer"
DISTRO_NAME = "FSLC FrameBuffer"

require conf/fragments/bsp/fslc.conf
require conf/fragments/graphics/framebuffer.conf
```

## conf/distro/fslc-wayland.conf
```bitbake
# FSLC Distro for Wayland.

require conf/distro/poky.conf

SDK_VENDOR = "-fslcsdk"

MAINTAINER = "FSL Community Team <meta-freescale@yoctoproject.org>"

TARGET_VENDOR = "-fslc"

DISTROOVERRIDES = "fslc"

require conf/distro/include/fsl-distro-common.inc

DISTRO = "fslc-wayland"
DISTRO_NAME = "FSLC Wayland"

# Define Init System
INIT_MANAGER = "systemd"

require conf/fragments/bsp/fslc.conf
require conf/fragments/graphics/wayland.conf
```

## conf/distro/fslc-x11.conf
```bitbake
# FSLC Distro for X11 without wayland.

require conf/distro/poky.conf

SDK_VENDOR = "-fslcsdk"

MAINTAINER = "FSL Community Team <meta-freescale@yoctoproject.org>"

TARGET_VENDOR = "-fslc"

DISTROOVERRIDES = "fslc"

require conf/distro/include/fsl-distro-common.inc

DISTRO = "fslc-x11"
DISTRO_NAME = "FSLC X11"

require conf/fragments/bsp/fslc.conf
require conf/fragments/graphics/x11.conf
```

## conf/distro/fslc-xwayland.conf
```bitbake
# FSLC Distro for Wayland with XWayland.

require conf/distro/poky.conf

SDK_VENDOR = "-fslcsdk"

MAINTAINER = "FSL Community Team <meta-freescale@yoctoproject.org>"

TARGET_VENDOR = "-fslc"

DISTROOVERRIDES = "fslc"

require conf/distro/include/fsl-distro-common.inc

DISTRO = "fslc-xwayland"
DISTRO_NAME = "FSLC Wayland with XWayland"

# Define Init System
INIT_MANAGER = "systemd"

require conf/fragments/bsp/fslc.conf
require conf/fragments/graphics/xwayland.conf
```

## conf/distro/include/fsl-base.inc
```bitbake
require conf/distro/include/fslc-base.inc

SDK_VENDOR = "-fslsdk"

MAINTAINER = "Freescale Semiconductors <lauren.post@nxp.com>"

TARGET_VENDOR = "-fsl"

DISTROOVERRIDES = "fsl"
```
